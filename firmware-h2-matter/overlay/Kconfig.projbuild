## firmware-h2-matter/overlay/Kconfig.projbuild
```kconfig
menu "Doorbell UART link"
config DB_H2_UART_RX
    int "UART RX GPIO (H2 pin from M5Stick GPIO32)"
    default 23
config DB_H2_UART_TX
    int "UART TX GPIO (H2 pin to M5Stick GPIO33)"
    default 24
endmenu
```

## firmware-h2/main/Kconfig.projbuild
```kconfig
menu "Doorbell Gateway H2 UART"
  config DB_UART_RX
    int "H2 RX GPIO (connected to Stick GPIO32 / TX)"
    default 4
  config DB_UART_TX
    int "H2 TX GPIO (connected to Stick GPIO33 / RX)"
    default 5
endmenu
```

## firmware-h2/sdkconfig.defaults
```kconfig
CONFIG_IDF_TARGET="esp32h2"
CONFIG_OPENTHREAD_ENABLED=y
CONFIG_OPENTHREAD_RADIO_NATIVE=y
CONFIG_OPENTHREAD_FTD=y
CONFIG_OPENTHREAD_NETWORK_NAME="DoorbellThread"
CONFIG_ESP_CONSOLE_USB_SERIAL_JTAG=y
CONFIG_PARTITION_TABLE_SINGLE_APP=y
```
